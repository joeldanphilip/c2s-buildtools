## trisul32_buildroot-master/buildroot/output/build/linux-5.4.1/drivers/net/ethernet/cdac/Kconfig
```kconfig
config CDAC_ENET
        tristate "CDAC ethernet MAC on CDAC devices"
        depends on ARCH_RV32I
        select PHYLIB
        help
	  Say Y or M here if you want to use the C-DAC GMAC included on
	  some CDAC RISCV devices. You can safely enable this option for CDAC
	  SoC. Also available as a module.
```

## trisul32_buildroot-master/buildroot/output/build/linux-5.4.1/drivers/net/ethernet/cdac/ermac/Kconfig
```kconfig
config NET_CDAC_ERMAC
        tristate "CDAC ethernet ERMAC (10/100) on C-DAC devices"
        depends on ARCH_RV32I
        select PHYLIB
        help
	  Say Y or M here if you want to use the C-DAC ethernet MAC (10/100) included on
	  some CDAC RISCV devices. You can safely enable this option for CDAC
	  SoC. Also available as a module.
```

## trisul32_buildroot-master/buildroot/output/build/linux-5.4.1/drivers/usb/vega/Kconfig
```kconfig
config USB_VEGA
	tristate "VEGA USB support"	
	select USB_COMMON
	---help---

	  If unsure, say N.

config USB_VEGA_HCD
	tristate "VEGA USB HCD Supported"
	depends on USB_VEGA && USB 
	help
	  Say Y or M here if your system as an VEGA USB host controller
	 
	  To compile this driver as a module, choose M here: the
	  module will be called vega-usb-hcd.
	  
config USB_VEGA_UDC
	tristate "VEGA USB UDC Supported"
	depends on USB_VEGA && USB_GADGET
	help
	  Say Y or M here if your system as an VEGA USB device controller
	 
	  To compile this driver as a module, choose M here: the
	  module will be called vega-usb-udc.
	  
	  

	  
```
